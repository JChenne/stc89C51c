#include <reg52.h>

sbit PWM=P0^0;
sbit led1=P0^1;
sbit led2=P0^2;
sbit led3=P0^3;
sbit led4=P0^4;
sbit led5=P0^5;
sbit led6=P0^6;
sbit led7=P0^7;
sbit key1=P1^0;
sbit key2=P1^1;
//--定义一个全局变量--//
unsigned char timer1; 

void Time1Config();

/*******************************************************************************
* 函 数 名       : main
* 函数功能		 : 主函数
* 输    入       : 无
* 输    出       : 无
*******************************************************************************/
void Delay10ms(unsigned int c)   //误差 0us
{
    unsigned char a, b;

	//--c已经在传递过来的时候已经赋值了，所以在for语句第一句就不用赋值了--//
    for (;c>0;c--)
	{
		for (b=38;b>0;b--)
		{
			for (a=130;a>0;a--);
		}
           
	}
        
}


void main(void)
{	
	 int	a=30,i;
	led1=0x00;
	led2=0x00;
	led3=0x00;
	led4=0x00;
	led5=0x00;
	led6=0x00;
	led7=0x00;

    
	Time1Config();
	while(1)
	{ 	
	
		if (key1 != 0xFF)		//检测按键K1是否按下
		{
			Delay10ms(1);	//消除抖动
	
			if (key1 != 0xFF)	//再次检测按键是否按下
			{
				Delay10ms(1);
			    a=a+5;
				i = 0;
				while ((i<50) && (key1 != 0xFF))	 //检测按键是否松开
				{
					Delay10ms(1);
					i++;
				}
			}
		}
		if (key2 != 0xFF)		//检测按键K1是否按下
		{
			Delay10ms(1);	//消除抖动
	
			if (key2 != 0xFF)	//再次检测按键是否按下
			{
				Delay10ms(1);
			    a=a-1;
				i = 0;
				while ((i<50) && (key1 != 0xFF))	 //检测按键是否松开
				{
					Delay10ms(1);
					i++;
				}
			}
		}
		if(timer1>50)  //PWM周期为100*0.5ms
		{
			timer1=0;
		}
		if(timer1 < a)	//改变30这个值可以改变直流电机的速度
		{
			PWM=1;
		}
		else
		{
			PWM=0;
		}
	}
	

 }

/*******************************************************************************
* 函 数 名       : Time1Config
* 函数功能		 : 设置定时器
* 输    入       : 无
* 输    出       : 无
*******************************************************************************/

void Time1Config()
{
	TMOD|= 0x10;   //设置定时计数器工作方式1为定时器

	//--定时器赋初始值，12MHZ下定时0.5ms--//  
	TH1 = 0xFE; 
	TL1 = 0x0C;

	
	ET1 = 1; 	 //开启定时器1中断
	EA = 1;
	TR1 = 1;	 //开启定时器	
}

/*******************************************************************************
* 函 数 名       : Time1
* 函数功能		 : 定时器1的中断函数
* 输    入       : 无
* 输    出       : 无
*******************************************************************************/

void Time1(void) interrupt 3    //3 为定时器1的中断号  1 定时器0的中断号 0 外部中断1 2 外部中断2  4 串口中断
{
	TH1 = 0xFE;  //重新赋初值
	TL1 = 0x0C;
	timer1++;    
}

